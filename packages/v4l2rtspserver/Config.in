## packages/v4l2rtspserver/Config.in
```kconfig
config BR2_PACKAGE_V4L2RTSPSERVER
	bool "v4l2rtspserver"
	help
          RTSP Server for V4L2 device capture supporting HEVC/H264/JPEG/VP8/VP9

          https://github.com/mpromonet/v4l2rtspserver
```
